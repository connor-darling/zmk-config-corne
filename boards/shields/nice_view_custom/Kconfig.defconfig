## boards/shields/nice_view_custom/Kconfig.defconfig
```kconfig
if SHIELD_NICE_VIEW_CUSTOM

choice ZMK_DISPLAY_STATUS_SCREEN
    default ZMK_DISPLAY_STATUS_SCREEN_CUSTOM
endchoice

choice ZMK_DISPLAY_WORK_QUEUE
    default ZMK_DISPLAY_WORK_QUEUE_DEDICATED
endchoice

choice LV_COLOR_DEPTH
    default LV_COLOR_DEPTH_1
endchoice

# Sharp Memory LCD driver
config LS0XX
    default y

# Display settings
config LV_DPI_DEF
    default 161

config LV_Z_VDB_SIZE
    default 100

config LV_Z_BITS_PER_PIXEL
    default 1

config LV_Z_MEM_POOL_SIZE
    default 8192

# LVGL widgets we use
config LV_USE_LABEL
    default y

config LV_USE_IMG
    default y

endif
```
